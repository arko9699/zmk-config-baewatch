#include <physical_layouts.dtsi>

/ {
    default_layout: default_layout {
        compatible = "zmk,physical-layout";
        display-name = "Default";
        transform = <&default_transform>;
        kscan = <&kscan>;

        keys  //                     w   h    x    y     rot    rx    ry
            = <&key_physical_attrs 150 100   50    0       0     0     0>
            , <&key_physical_attrs 200 100    0  100       0     0     0>
            ;
    };
};

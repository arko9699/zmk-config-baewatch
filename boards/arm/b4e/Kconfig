## boards/arm/b4e/Kconfig
```kconfig
if BOARD_B4E

config BOARD_ENABLE_DCDC
    bool "DCDC mode"
    select SOC_DCDC_NRF52X
    default y

# Uncomment this block if you are powering the SoC from the VDDH pin and have
# an inductor between VDD and DCCH. Otherwise, delete this block.
# WARNING: uncommenting this without the correct inductor will brick the device
# and require reprogramming it with a J-Link or similar debug probe!

config BOARD_ENABLE_DCDC_HV
    bool "High Voltage DCDC converter"
    select SOC_DCDC_NRF52X_HV
    default y

endif # BOARD_B4E
```

## boards/arm/b4e/Kconfig.defconfig
```kconfig
if BOARD_B4E

config ZMK_KEYBOARD_NAME
    default "baewatch"

if USB

config USB_NRFX
    default y

config USB_DEVICE_STACK
    default y

endif # USB

config BT_CTLR
    default BT

endif # BOARD_B4E
```
